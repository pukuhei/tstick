## config/Kconfig
```kconfig
menu "tstick extras"

menuconfig SENSOR_ROTATION
    bool "Enable sensor rotation module"
    default y

if SENSOR_ROTATION

config SENSOR_ROTATION_ANGLE
    int "Sensor rotation angle (degrees)"
    default 0
    range 0 360

config ZMK_BEHAVIOR_SENSOR_ROTATION_STEP
    bool "Enable sensor rotation step behavior"
    default y

endif # SENSOR_ROTATION

endmenu
```

## config/boards/shields/tstick/Kconfig.defconfig
```kconfig
if SHIELD_TSTICK

config ZMK_KEYBOARD_NAME
    default "tstick"

config ZMK_SPLIT
    default n

endif
```

## config/dts/bindings/behaviors/zmk,behavior-angle-step.yaml
```yaml
# Copyright (c) 2025
# SPDX-License-Identifier: MIT

description: Sensor rotation step behavior

compatible: "zmk,behavior-angle-step"

include: zero_param.yaml

properties:
  sensor-rotation:
    type: phandle
    required: true
  step-deg:
    type: int
    required: true
  min-angle:
    type: int
    default: 0
  max-angle:
    type: int
    default: 315
  wrap-around:
    type: boolean
```

## config/dts/bindings/input_processors/zmk,input-processor-sensor-rotation.yaml
```yaml
# Copyright (c) 2025
# SPDX-License-Identifier: MIT

description: Input Processor for sensor rotation

compatible: "zmk,input-processor-sensor-rotation"

include: ip_zero_param.yaml

properties:
  rotation-angle:
    type: int
    required: true
```

## config/west.yml
```yaml
manifest:
  remotes:
    - name: zmkfirmware
      url-base: https://github.com/zmkfirmware
    - name: badjeff
      url-base: https://github.com/badjeff
    - name: caksoylar
      url-base: https://github.com/caksoylar
    - name: hsgw
      url-base: https://github.com/hsgw
  projects:
    - name: zmk
      remote: zmkfirmware
      revision: main
      import: app/west.yml
    - name: zmk-pmw3610-driver
      remote: badjeff
      revision: main
    - name: zmk-rgbled-widget
      remote: caksoylar
      revision: main
    - name: zmk-feature-sensor_rotation
      remote: hsgw
      revision: main
  self:
    path: config
```
